## Kconfig.projbuild
```kconfig
menu "OTA websocket update"

    config OTA_DEFAULT_URI
        string "OTA page URI"
        default "/ota"
        help
            WEB page URI to OTA update.

    config OTA_DEFAULT_WS_URI
        string "OTA ws URI"
        default "/ota/ws"
        help
            WEB ws URI to OTA update.

    config OTA_CHUNK_SIZE
        int "Ota chunk size"
        default 8192
        help
            Ota download chunk size.

    config OTA_PRE_ENCRYPTED_MODE
        bool "Ota pre-encrypted mode"
        default n
        help
            Ota pre-encrypted mode.

    choice  OTA_PRE_ENCRYPTED_RSA_KEY_LOCATION
        depends on OTA_PRE_ENCRYPTED_MODE
        prompt "RSA key directory"
        default OTA_PRE_ENCRYPTED_RSA_KEY_ON_COMPONENT_LOCATION
            config OTA_PRE_ENCRYPTED_RSA_KEY_ON_PROJECT_LOCATION
                bool "PROJECT_DIR"
            config OTA_PRE_ENCRYPTED_RSA_KEY_ON_COMPONENT_LOCATION
                bool "COMPONENT_DIR"
    endchoice

    config OTA_PRE_ENCRYPTED_RSA_KEY_DIRECTORY
        depends on OTA_PRE_ENCRYPTED_MODE
        string  "Ota pre-encrypted RSA key directory"
        default "rsa_key"


endmenu
```
